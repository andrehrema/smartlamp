## main/Kconfig.projbuild
```kconfig
menu "WiFi Configuration"

    config WIFI_SSID
        string "WiFi SSID"
        help
        SSID (network name) of the WiFi network to connect to.

    config WIFI_PASSWORD
        string "WiFi Password"
        help
        Password of the WiFi network to connect to.

endmenu

menu "MQTT Configuration"

    config MQTT_BROKER_IP
        string "MQTT Broker IP"
        help
        Hostname or IP address of the MQTT broker.

    config MQTT_PORT
        int "MQTT Port"
        default 8883
        help
        Port of the MQTT broker.

endmenu
```
